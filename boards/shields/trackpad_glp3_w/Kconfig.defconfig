## boards/shields/trackpad_glp3_w/Kconfig.defconfig
```kconfig
if SHIELD_TRACKPAD_GLP3_W

config ZMK_KEYBOARD_NAME
    default "trackpad_glp3_w"

endif
```

## boards/shields/trackpad_glp3_w/Kconfig.shield
```kconfig
config SHIELD_TRACKPAD_GLP3_W
    def_bool $(shields_list_contains,trackpad_glp3_w)
```

## boards/shields/trackpad_glp3_wl/Kconfig.defconfig
```kconfig
if SHIELD_TRACKPAD_GLP3_WL

config ZMK_KEYBOARD_NAME
    default "trackpad_glp3_wl"

endif
```

## boards/shields/trackpad_glp3_wl/Kconfig.shield
```kconfig
config SHIELD_TRACKPAD_GLP3_WL
    def_bool $(shields_list_contains,trackpad_glp3_wl)
```
